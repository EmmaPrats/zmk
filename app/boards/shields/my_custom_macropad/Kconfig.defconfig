## app/boards/shields/my_custom_macropad/Kconfig.defconfig
```kconfig
if SHIELD_MY_CUSTOM_MACROPAD

config ZMK_KEYBOARD_NAME
	default "My Custom Macropad"

config USB
	default y

endif
```

## app/boards/shields/my_custom_macropad/Kconfig.shield
```kconfig
# SPDX-License-Identifier: MIT

config SHIELD_MY_CUSTOM_MACROPAD
    def_bool $(shields_list_contains,my_custom_macropad)
```
